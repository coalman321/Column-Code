## firmware/main/Kconfig.projbuild
```kconfig
menu "Column Firmware Configuration"

    config WIFI_SSID
        string "WiFi SSID"
        default "myssid"
        help
            SSID of the WiFi network to connect to.

    config WIFI_PASSWORD
        string "WiFi Password"
        default "mypassword"
        help
            Password for the WiFi network.

    config MQTT_BROKER_URL
        string "MQTT Broker URL"
        default "mqtt://192.168.1.1:1883"
        help
            URL of the MQTT broker (e.g. mqtt://192.168.1.100:1883).
            All real-time communication (color, heartbeat, logs, commands)
            uses MQTT.

    config SERVER_BASE_URL
        string "HTTP Server Base URL (OTA only)"
        default "http://192.168.1.1:8000"
        help
            Base URL of the HTTP server used only for OTA firmware updates
            (/firmware/hash and /firmware/bin endpoints).

    config SERVER_TIMEOUT_MINUTES
        int "Server unreachable timeout (minutes)"
        default 10
        range 1 60
        help
            How long to keep retrying the server before entering light sleep.

    config WAKEUP_GPIO_PIN
        int "Wakeup GPIO pin"
        default 9
        range 0 30
        help
            GPIO pin that wakes the device from light sleep. Pin 9 is the BOOT
            button on most ESP32-C6 devkits.

    config WAKEUP_GPIO_ACTIVE_LOW
        bool "Wakeup GPIO is active low"
        default y
        help
            Enable if the wakeup pin is pulled high and driven low to trigger
            (e.g. a button to GND with internal pull-up). Disable for active high.

    config HEARTBEAT_INTERVAL_SECONDS
        int "Heartbeat interval (seconds)"
        default 30
        range 1 120
        help
            How often the device publishes to devices/{mac}/heartbeat to signal
            it is online.

    config OTA_CHECK_INTERVAL_MINUTES
        int "OTA check interval (minutes)"
        default 60
        range 1 1440
        help
            How often to compare the running firmware hash with the server and
            apply an update if they differ.

    config MQTT_ACTIVITY_GPIO_PIN
        int "MQTT activity indicator GPIO pin"
        default 15
        range 0 30
        help
            GPIO pin driven high briefly on every MQTT publish or received
            message. Useful for a status LED or logic analyser trigger.

    config MQTT_ACTIVITY_PULSE_MS
        int "MQTT activity pulse duration (ms)"
        default 50
        range 1 500
        help
            How long the activity pin stays high after an MQTT transaction.

    config COLOR_GPIO_DATA
        int "GPIO for SK6812 data line"
        default 4
        range 0 30
        help
            GPIO pin connected to the DIN pin of the first SK6812 LED.

    config COLOR_NUM_LEDS
        int "Number of SK6812 LEDs"
        default 4
        range 1 256
        help
            Number of SK6812 RGBW LEDs in the chain.

endmenu
```

## firmware/sdkconfig.defaults
```kconfig
# Target
CONFIG_IDF_TARGET="esp32c6"

# Flash
CONFIG_ESPTOOLPY_FLASHSIZE_4MB=y
CONFIG_ESPTOOLPY_FLASHSIZE="4MB"

# Increase main task stack for HTTP client
CONFIG_ESP_MAIN_TASK_STACK_SIZE=8192

# OTA partition table
CONFIG_PARTITION_TABLE_CUSTOM=y
CONFIG_PARTITION_TABLE_CUSTOM_FILENAME="partitions.csv"

# Allow HTTP (non-TLS) OTA downloads
CONFIG_ESP_HTTPS_OTA_ALLOW_HTTP=y
```
